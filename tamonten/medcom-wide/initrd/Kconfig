## tamonten/medcom-wide/initrd/Kconfig
```kconfig
config PLATFORM_AVIONIC_DESIGN_TAMONTEN_MEDCOM_WIDE_INITRD
	select PLATFORM_GENERIC_INITRD
	bool "Initial Ramdisk"
```

## tamonten/medcom-wide/rootfs/Kconfig
```kconfig
config PLATFORM_AVIONIC_DESIGN_TAMONTEN_MEDCOM_WIDE_ROOTFS
	bool "Root Filesystem"
```

## tamonten/plutux/Kconfig
```kconfig
if PLATFORM_AVIONIC_DESIGN_TAMONTEN_PLUTUX

choice
	prompt "Avionic Design Plutux"

source "platforms/avionic-design/tamonten/plutux/initrd/Kconfig"
source "platforms/avionic-design/tamonten/plutux/rootfs/Kconfig"

endchoice

endif
```

## tamonten/plutux/initrd/Kconfig
```kconfig
config PLATFORM_AVIONIC_DESIGN_TAMONTEN_PLUTUX_INITRD
	select PLATFORM_GENERIC_INITRD
	bool "Initial Ramdisk"
```

## tamonten/plutux/rootfs/Kconfig
```kconfig
config PLATFORM_AVIONIC_DESIGN_TAMONTEN_PLUTUX_ROOTFS
	bool "Root Filesystem"
	select PLATFORM_AVIONIC_DESIGN_TAMONTEN_PLUTUX_BINARIES
```

## tamonten/tec/Kconfig
```kconfig
if PLATFORM_AVIONIC_DESIGN_TAMONTEN_TEC

choice
	prompt "Avionic Design Tamonten Evaluation Carrier"

source "platforms/avionic-design/tamonten/tec/initrd/Kconfig"
source "platforms/avionic-design/tamonten/tec/rootfs/Kconfig"

endchoice

endif
```

## tamonten/tec/initrd/Kconfig
```kconfig
config PLATFORM_AVIONIC_DESIGN_TAMONTEN_TEC_INITRD
	select PLATFORM_GENERIC_INITRD
	bool "Initial Ramdisk"
```

## tec/Kconfig
```kconfig
if PLATFORM_AVIONIC_DESIGN_TEC

choice
	prompt "Avionic Design Tamonten Evaluation Carrier"

source "platforms/avionic-design/tec/initrd/Kconfig"
source "platforms/avionic-design/tec/rootfs/Kconfig"

endchoice

endif
```

## tec/initrd/Kconfig
```kconfig
config PLATFORM_AVIONIC_DESIGN_TEC_INITRD
	select PLATFORM_GENERIC_INITRD
	bool "Initial Ramdisk"
```

## xanthos/Kconfig
```kconfig
if PLATFORM_AVIONIC_DESIGN_XANTHOS

choice
	prompt "Avionic Design Xanthos"

config PLATFORM_AVIONIC_DESIGN_XANTHOS_MEDCOM
	bool "Avionic Design Med@com"

endchoice

source "platforms/avionic-design/xanthos/medcom/Kconfig"

endif
```
