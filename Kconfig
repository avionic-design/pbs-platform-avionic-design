## Kconfig
```kconfig
if PLATFORM_AVIONIC_DESIGN

choice
	prompt "Avionic Design"

config PLATFORM_AVIONIC_DESIGN_XANTHOS
	bool "Xanthos"

config PLATFORM_AVIONIC_DESIGN_MEDATOM
	bool "Medatom"

config PLATFORM_AVIONIC_DESIGN_MEDATOM_NG
	bool "Medatom NG"

config PLATFORM_AVIONIC_DESIGN_MEDCOM_WIDE
	bool "Medcom-Wide"
	select ARCH_TEGRA_2x_SOC

config PLATFORM_AVIONIC_DESIGN_PLUTUX
	bool "Plutux"
	select ARCH_TEGRA_2x_SOC

config PLATFORM_AVIONIC_DESIGN_TEC
	bool "Avionic Design Tamonten Evaluation Carrier"
	select ARCH_TEGRA_2x_SOC

endchoice

source "platforms/avionic-design/xanthos/Kconfig"
source "platforms/avionic-design/medatom/Kconfig"
source "platforms/avionic-design/medatom-ng/Kconfig"
source "platforms/avionic-design/medcom-wide/Kconfig"
source "platforms/avionic-design/plutux/Kconfig"
source "platforms/avionic-design/tec/Kconfig"

endif
```

## configs/medatom-ng-rootfs_defconfig
```kconfig
CONFIG_ARCH_X86=y
CONFIG_ARCH_X86_I786=y
CONFIG_OS_LINUX=y
CONFIG_GLIBC=y
CONFIG_OPTIMIZATION_SPEED=y
CONFIG_PLATFORM_AVIONIC_DESIGN=y
CONFIG_PLATFORM_AVIONIC_DESIGN_MEDATOM_NG=y
CONFIG_PLATFORM_AVIONIC_DESIGN_MEDATOM_NG_ROOTFS=y
CONFIG_PACKAGE_KERNEL_LINUX_SOURCE_GIT=y
CONFIG_PACKAGE_KERNEL_LINUX_SOURCE_GIT_URL="git://github.com/avionic-design/linux.git"
CONFIG_PACKAGE_KERNEL_LINUX_SOURCE_GIT_CHECKOUT="medatom/master"
CONFIG_PACKAGE_KERNEL_LINUX_CONFIG="medatom_defconfig"
CONFIG_PACKAGE_KERNEL_LINUX_BUILD_DTBS=y
CONFIG_PACKAGE_KERNEL_LINUX_DTB="medatom-wide"
CONFIG_PACKAGE_DEVEL_FILE=y
CONFIG_PACKAGE_DEVEL_GDB=y
CONFIG_PACKAGE_DEVEL_LUA=y
CONFIG_PACKAGE_DEVEL_STRACE=y
CONFIG_PACKAGE_CORE_BUSYBOX=y
CONFIG_PACKAGE_CORE_COREUTILS=y
CONFIG_PACKAGE_CORE_CPUFREQUTILS=y
CONFIG_PACKAGE_CORE_DMIDECODE=y
CONFIG_PACKAGE_CORE_E2FSPROGS=y
CONFIG_PACKAGE_CORE_GREP=y
CONFIG_PACKAGE_CORE_LESS=y
CONFIG_PACKAGE_CORE_LOGROTATE=y
CONFIG_PACKAGE_CORE_PCIUTILS=y
CONFIG_PACKAGE_CORE_PROCPS=y
CONFIG_PACKAGE_CORE_PSMISC=y
CONFIG_PACKAGE_CORE_SED=y
CONFIG_PACKAGE_CORE_SYSLINUX=y
CONFIG_PACKAGE_CORE_USBUTILS=y
CONFIG_PACKAGE_CORE_UTIL_LINUX_PAM=y
CONFIG_PACKAGE_LIBS_BZIP2=y
CONFIG_PACKAGE_LIBS_DBUS_SYSTEMD=y
CONFIG_PACKAGE_LIBS_IMLIB2=y
CONFIG_PACKAGE_LIBS_LIBNOTIFY=y
CONFIG_PACKAGE_LIBS_LIBSECRET=y
CONFIG_PACKAGE_LIBS_LIBWEBP=y
CONFIG_PACKAGE_LIBS_LIBXDG_BASEDIR=y
CONFIG_PACKAGE_LIBS_LZO=y
CONFIG_PACKAGE_LIBS_MESA_DRI_I915=y
CONFIG_PACKAGE_LIBS_MESA_DRI_I965=y
CONFIG_PACKAGE_LIBS_ORC=y
CONFIG_PACKAGE_LIBS_PCSC_LITE=y
CONFIG_PACKAGE_LIBS_PCSC_DRIVERS_CCID=y
CONFIG_PACKAGE_LIBS_STARTUP_NOTIFICATION=y
CONFIG_PACKAGE_SHELLS_BASH=y
CONFIG_PACKAGE_NET_CA_CERTIFICATES=y
CONFIG_PACKAGE_NET_DDIP=y
CONFIG_PACKAGE_NET_DHCPCD=y
CONFIG_PACKAGE_NET_ETHTOOL=y
CONFIG_PACKAGE_NET_IFLINKD=y
CONFIG_PACKAGE_NET_LLDPD=y
CONFIG_PACKAGE_NET_LLDPD_SNMP=y
CONFIG_PACKAGE_NET_NTPD=y
CONFIG_PACKAGE_NET_PROXYCONF=y
CONFIG_PACKAGE_NET_FUSE_SSHFS=y
CONFIG_PACKAGE_NET_TCPDUMP=y
CONFIG_PACKAGE_CONSOLE_FBSET=y
CONFIG_PACKAGE_CONSOLE_KBD=y
CONFIG_PACKAGE_CONSOLE_TMUX=y
CONFIG_PACKAGE_EDITORS_NANO=y
CONFIG_PACKAGE_EDITORS_VIM=y
CONFIG_PACKAGE_MULTIMEDIA_ALSA_UTILS=y
CONFIG_PACKAGE_MULTIMEDIA_BCG729=y
CONFIG_PACKAGE_MULTIMEDIA_GSTREAMER_PLUGINS_GOOD=y
CONFIG_PACKAGE_MULTIMEDIA_GSTREAMER_PLUGINS_BAD=y
CONFIG_PACKAGE_MULTIMEDIA_GSTREAMER_PLUGINS_UGLY=y
CONFIG_PACKAGE_MULTIMEDIA_GSTREAMER_DISABLE_ORC=y
CONFIG_PACKAGE_MULTIMEDIA_GSTREAMER_DISABLE_RARE=y
CONFIG_PACKAGE_MULTIMEDIA_LIBTHEORA=y
CONFIG_PACKAGE_MULTIMEDIA_LIBTREMOR=y
CONFIG_PACKAGE_MULTIMEDIA_LINPHONE_GTK=y
CONFIG_PACKAGE_MULTIMEDIA_VAAPI_LIBVA_INTEL=y
CONFIG_PACKAGE_MULTIMEDIA_VLC_TELETEXT=y
CONFIG_PACKAGE_MULTIMEDIA_VLC_VAAPI=y
CONFIG_PACKAGE_MULTIMEDIA_WSCAN=y
CONFIG_PACKAGE_WEB_FREERDP=y
CONFIG_PACKAGE_WEB_WEBKIT_GTK_ENABLE_VIDEO=y
CONFIG_PACKAGE_WEB_WEBKIT_GTK_ENABLE_ACCELERATED_COMPOSITING=y
CONFIG_PACKAGE_WEB_WEBKIT_GTK_ENABLE_WEBGL=y
CONFIG_PACKAGE_WEB_WEBKIT_GTK_ENABLE_ANIM_API=y
CONFIG_PACKAGE_WEB_WEBKIT_GTK_ENABLE_WEBKIT2=y
CONFIG_PACKAGE_WEB_X11VNC=y
CONFIG_PACKAGE_XORG_APP_EVTEST=y
CONFIG_PACKAGE_XORG_APP_SETXKBMAP=y
CONFIG_PACKAGE_XORG_APP_XBACKLIGHT=y
CONFIG_PACKAGE_XORG_APP_XINIT=y
CONFIG_PACKAGE_XORG_APP_XINPUT=y
CONFIG_PACKAGE_XORG_APP_XKBCOMP=y
CONFIG_PACKAGE_XORG_APP_XRANDR=y
CONFIG_PACKAGE_XORG_APP_XSET=y
CONFIG_PACKAGE_XORG_APP_XTERM=y
CONFIG_PACKAGE_XORG_DATA_XKEYBOARD_CONFIG=y
CONFIG_PACKAGE_XORG_DRIVER_INPUT_EVDEV=y
CONFIG_PACKAGE_XORG_DRIVER_INPUT_KEYBOARD=y
CONFIG_PACKAGE_XORG_DRIVER_INPUT_MOUSE=y
CONFIG_PACKAGE_XORG_DRIVER_VIDEO_FBDEV=y
CONFIG_PACKAGE_XORG_DRIVER_VIDEO_INTEL=y
CONFIG_PACKAGE_XORG_LIB_XCB_UTIL_IMAGE=y
CONFIG_PACKAGE_XORG_LIB_XCB_UTIL_WM=y
CONFIG_PACKAGE_XORG_LIB_XSS=y
CONFIG_XORG_AIGLX=y
CONFIG_XORG_DRI=y
CONFIG_XORG_GLX=y
CONFIG_XORG_XV=y
CONFIG_XORG_XINERAMA=y
CONFIG_PACKAGE_DESKTOP_EVDEV_CALIBRATE=y
CONFIG_PACKAGE_DESKTOP_GTK_ENGINES=y
CONFIG_PACKAGE_DESKTOP_ICONS_HICOLOR=y
CONFIG_PACKAGE_DESKTOP_ICONS_TANGO=y
CONFIG_PACKAGE_DESKTOP_NODM=y
CONFIG_PACKAGE_WM_DWM=y
CONFIG_PACKAGE_UTIL_FLASHTOOL=y
CONFIG_PACKAGE_UTIL_HTOP=y
CONFIG_PACKAGE_UTIL_I2C_TOOLS=y
CONFIG_PACKAGE_UTIL_IRKEY=y
CONFIG_PACKAGE_UTIL_MESA_DEMOS=y
CONFIG_PACKAGE_FONTS_TTF_ARPHIC_UMING=y
CONFIG_PACKAGE_FONTS_TTF_BITSTREAM_VERA=y
CONFIG_PACKAGE_FONTS_TTF_FREEFONT=y
CONFIG_PACKAGE_FONTS_TTF_LIBERATION=y
CONFIG_PACKAGE_VENDOR_AVIONIC_DESIGN_MEDATOM_UTILS=y
CONFIG_PACKAGE_VENDOR_AVIONIC_DESIGN_REMOTE_CONTROL_BACKLIGHT_MEDATOM=y
CONFIG_PACKAGE_VENDOR_AVIONIC_DESIGN_REMOTE_CONTROL_VIDEO_VLC=y
CONFIG_PACKAGE_VENDOR_AVIONIC_DESIGN_REMOTE_CONTROL_SMARTCARD_LIBSMARTCARD=y
CONFIG_PACKAGE_VENDOR_AVIONIC_DESIGN_REMOTE_CONTROL_SMARTCARD_LIBPCSCLITE=y
CONFIG_PACKAGE_VENDOR_AVIONIC_DESIGN_REMOTE_CONTROL_SMARTCARD_INFO=y
CONFIG_PACKAGE_VENDOR_AVIONIC_DESIGN_REMOTE_CONTROL_VOIP_LINPHONE=y
CONFIG_PACKAGE_VENDOR_AVIONIC_DESIGN_REMOTE_CONTROL_GPIO_SYSFS=y
CONFIG_PACKAGE_VENDOR_AVIONIC_DESIGN_REMOTE_CONTROL_JAVASCRIPT_APP_WATCHDOG=y
CONFIG_PACKAGE_VENDOR_AVIONIC_DESIGN_REMOTE_CONTROL_WATCHDOG=y
CONFIG_PACKAGE_VENDOR_AVIONIC_DESIGN_REMOTE_CONTROL_AUDIO_ALSA=y
CONFIG_PACKAGE_VENDOR_AVIONIC_DESIGN_RUM=y
CONFIG_OPENGL_MESA_OPENGL_ES1=y
CONFIG_OPENGL_MESA_OPENGL_ES2=y
CONFIG_OPENGL_MESA_OPENGL=y
CONFIG_UDEV_SYSTEMD=y
CONFIG_VIRTUAL_LIBS_GTK_GTK3=y
```

## configs/medcom-wide-rootfs_defconfig
```kconfig
CONFIG_ARCH_ARM=y
CONFIG_ARCH_ARM_CPU_CORTEX_A9=y
CONFIG_ARCH_TEGRA_2x_SOC=y
CONFIG_ARCH_ARM_ABI_EABI=y
CONFIG_OS_LINUX=y
CONFIG_GLIBC=y
CONFIG_PLATFORM_AVIONIC_DESIGN=y
CONFIG_PLATFORM_AVIONIC_DESIGN_MEDCOM_WIDE=y
CONFIG_PLATFORM_AVIONIC_DESIGN_MEDCOM_WIDE_ROOTFS=y
CONFIG_PLATFORM_AVIONIC_DESIGN_MEDCOM_WIDE_ROOTFS_DEFAULTS=y
CONFIG_PACKAGE_BUILD_TOOLS_CMAKE=y
CONFIG_PACKAGE_BUILD_TOOLS_LIBIDL=y
CONFIG_PACKAGE_KERNEL_LINUX_SOURCE_GIT=y
CONFIG_PACKAGE_KERNEL_LINUX_SOURCE_GIT_URL="git://github.com/avionic-design/linux-l4t.git"
CONFIG_PACKAGE_KERNEL_LINUX_SOURCE_GIT_CHECKOUT="tamonten/l4t-r16-3"
CONFIG_PACKAGE_KERNEL_LINUX_CONFIG="medcom-wide_defconfig"
CONFIG_PACKAGE_DEVEL_FILE=y
CONFIG_PACKAGE_DEVEL_GDB=y
CONFIG_PACKAGE_DEVEL_LUA=y
CONFIG_PACKAGE_DEVEL_STRACE=y
CONFIG_PACKAGE_CORE_BUSYBOX=y
CONFIG_PACKAGE_CORE_COREUTILS=y
CONFIG_PACKAGE_CORE_E2FSPROGS=y
CONFIG_PACKAGE_CORE_GREP=y
CONFIG_PACKAGE_CORE_LESS=y
CONFIG_PACKAGE_CORE_LOGROTATE=y
CONFIG_PACKAGE_CORE_PCIUTILS=y
CONFIG_PACKAGE_CORE_PROCPS=y
CONFIG_PACKAGE_CORE_PSMISC=y
CONFIG_PACKAGE_CORE_RSYSLOG=y
CONFIG_PACKAGE_CORE_UTIL_LINUX_PAM=y
CONFIG_PACKAGE_LIBS_AT_SPI2_ATK=y
CONFIG_PACKAGE_LIBS_BZIP2=y
CONFIG_PACKAGE_LIBS_LIBCCID=y
CONFIG_PACKAGE_LIBS_LIBDRM=y
CONFIG_PACKAGE_LIBS_LIBNOTIFY=y
CONFIG_PACKAGE_LIBS_LIBSECRET=y
CONFIG_PACKAGE_LIBS_LIBWEBP=y
CONFIG_PACKAGE_LIBS_LIBXDG_BASEDIR=y
CONFIG_PACKAGE_LIBS_LZO=y
CONFIG_PACKAGE_LIBS_NSS=y
CONFIG_PACKAGE_LIBS_ORC=y
CONFIG_PACKAGE_LIBS_PCSC_LITE=y
CONFIG_PACKAGE_LIBS_STARTUP_NOTIFICATION=y
CONFIG_PACKAGE_SHELLS_BASH=y
CONFIG_PACKAGE_NET_DDIP=y
CONFIG_PACKAGE_NET_DHCPCD=y
CONFIG_PACKAGE_NET_ETHTOOL=y
CONFIG_PACKAGE_NET_IFLINKD=y
CONFIG_PACKAGE_NET_IPERF=y
CONFIG_PACKAGE_NET_LLDPD=y
CONFIG_PACKAGE_NET_NTPD=y
CONFIG_PACKAGE_NET_PROXYCONF=y
CONFIG_PACKAGE_NET_FUSE_SSHFS=y
CONFIG_PACKAGE_NET_TCPDUMP=y
CONFIG_PACKAGE_CONSOLE_FBSET=y
CONFIG_PACKAGE_CONSOLE_KBD=y
CONFIG_PACKAGE_CONSOLE_TMUX=y
CONFIG_PACKAGE_EDITORS_NANO=y
CONFIG_PACKAGE_EDITORS_VIM=y
CONFIG_PACKAGE_MULTIMEDIA_ALSA_UTILS=y
CONFIG_PACKAGE_MULTIMEDIA_BCG729=y
CONFIG_PACKAGE_MULTIMEDIA_GSTREAMER_0_10_PLUGINS_GOOD=y
CONFIG_PACKAGE_MULTIMEDIA_GSTREAMER_0_10_PLUGINS_UGLY=y
CONFIG_PACKAGE_MULTIMEDIA_LIBTHEORA=y
CONFIG_PACKAGE_MULTIMEDIA_LIBTREMOR=y
CONFIG_PACKAGE_MULTIMEDIA_LINPHONE_GTK=y
CONFIG_PACKAGE_MULTIMEDIA_LINPHONE_SPEEX=y
CONFIG_PACKAGE_MULTIMEDIA_VLC_PLUGIN_GLES2=y
CONFIG_PACKAGE_MULTIMEDIA_WSCAN=y
CONFIG_PACKAGE_WEB_FREERDP=y
CONFIG_PACKAGE_WEB_WEBKIT_GTK_UNICODE_BACKEND_ICU=y
CONFIG_PACKAGE_WEB_WEBKIT_GTK_ENABLE_VIDEO=y
CONFIG_PACKAGE_WEB_X11VNC=y
CONFIG_PACKAGE_XORG_APP_EVTEST=y
CONFIG_PACKAGE_XORG_APP_SETXKBMAP=y
CONFIG_PACKAGE_XORG_APP_XINIT=y
CONFIG_PACKAGE_XORG_APP_XKBCOMP=y
CONFIG_PACKAGE_XORG_APP_XRANDR=y
CONFIG_PACKAGE_XORG_APP_XTERM=y
CONFIG_PACKAGE_XORG_DATA_XKEYBOARD_CONFIG=y
CONFIG_PACKAGE_XORG_DRIVER_INPUT_EVDEV=y
CONFIG_PACKAGE_XORG_DRIVER_INPUT_KEYBOARD=y
CONFIG_PACKAGE_XORG_DRIVER_INPUT_MOUSE=y
CONFIG_PACKAGE_XORG_LIB_XCB_UTIL_IMAGE=y
CONFIG_PACKAGE_XORG_LIB_XCB_UTIL_WM=y
CONFIG_PACKAGE_XORG_LIB_XSS=y
CONFIG_PACKAGE_XORG_LIB_XXF86VM=y
CONFIG_PACKAGE_XORG_PROTO_DRI2=y
CONFIG_XORG_XV=y
CONFIG_XORG_XINERAMA=y
CONFIG_PACKAGE_DESKTOP_EVDEV_CALIBRATE=y
CONFIG_PACKAGE_DESKTOP_GTK_ENGINES=y
CONFIG_PACKAGE_DESKTOP_ICONS_HICOLOR=y
CONFIG_PACKAGE_DESKTOP_ICONS_TANGO=y
CONFIG_PACKAGE_DESKTOP_NODM=y
CONFIG_PACKAGE_WM_OPENBOX=y
CONFIG_PACKAGE_UTIL_ADAK=y
CONFIG_PACKAGE_UTIL_FLASHTOOL=y
CONFIG_PACKAGE_UTIL_HTOP=y
CONFIG_PACKAGE_UTIL_I2C_TOOLS=y
CONFIG_PACKAGE_UTIL_MTD_UTILS=y
CONFIG_PACKAGE_UTIL_MTD_UTILS_WITHOUT_LZO=y
CONFIG_PACKAGE_FONTS_TTF_BITSTREAM_VERA=y
CONFIG_PACKAGE_FONTS_TTF_FREEFONT=y
CONFIG_PACKAGE_FONTS_TTF_LIBERATION=y
CONFIG_PACKAGE_VENDOR_AVIONIC_DESIGN_MEDCOM_WIDE_UTILS=y
CONFIG_PACKAGE_VENDOR_AVIONIC_DESIGN_REMOTE_CONTROL_AUDIO_ALSA=y
CONFIG_PACKAGE_VENDOR_AVIONIC_DESIGN_REMOTE_CONTROL_BACKLIGHT_SYSFS=y
CONFIG_PACKAGE_VENDOR_AVIONIC_DESIGN_REMOTE_CONTROL_VIDEO_VLC=y
CONFIG_PACKAGE_VENDOR_AVIONIC_DESIGN_REMOTE_CONTROL_SMARTCARD_LIBSMARTCARD=y
CONFIG_PACKAGE_VENDOR_AVIONIC_DESIGN_REMOTE_CONTROL_VOIP_LINPHONE=y
CONFIG_PACKAGE_VENDOR_AVIONIC_DESIGN_REMOTE_CONTROL_MODEM_LIBMODEM=y
CONFIG_PACKAGE_VENDOR_AVIONIC_DESIGN_REMOTE_CONTROL_GPIO_SYSFS=y
CONFIG_PACKAGE_VENDOR_AVIONIC_DESIGN_REMOTE_CONTROL_JAVASCRIPT=y
CONFIG_PACKAGE_VENDOR_AVIONIC_DESIGN_REMOTE_CONTROL_JAVASCRIPT_APP_WATCHDOG=y
CONFIG_PACKAGE_VENDOR_AVIONIC_DESIGN_REMOTE_CONTROL_MODEM_LIBMODEM_ALSALOOP=y
CONFIG_PACKAGE_VENDOR_AVIONIC_DESIGN_REMOTE_CONTROL_VIDEO_VLC_LIBTNJ3324=y
CONFIG_PACKAGE_VENDOR_AVIONIC_DESIGN_REMOTE_CONTROL_WATCHDOG=y
CONFIG_PACKAGE_VENDOR_AVIONIC_DESIGN_RUM=y
CONFIG_LIBAV_LIBAV=y
CONFIG_OPENGL_NVIDIA_L4T_T2=y
CONFIG_UDEV_SYSTEMD=y
```

## configs/medcom-wide-setup_defconfig
```kconfig
CONFIG_ARCH_ARM=y
CONFIG_ARCH_ARM_CPU_CORTEX_A9=y
CONFIG_ARCH_TEGRA_2x_SOC=y
CONFIG_ARCH_ARM_ABI_EABI=y
CONFIG_OS_LINUX=y
CONFIG_PLATFORM_AVIONIC_DESIGN=y
CONFIG_PACKAGE_KERNEL_LINUX_CONFIG="medcom-wide_defconfig"
CONFIG_PLATFORM_AVIONIC_DESIGN_MEDCOM_WIDE=y
CONFIG_PLATFORM_AVIONIC_DESIGN_MEDCOM_WIDE_SETUP=y
CONFIG_PACKAGE_KERNEL_LINUX_SOURCE_GIT=y
CONFIG_PACKAGE_KERNEL_LINUX_SOURCE_GIT_URL="git://github.com/avionic-design/linux-l4t.git"
CONFIG_PACKAGE_KERNEL_LINUX_SOURCE_GIT_CHECKOUT="tamonten/l4t-r16-3"
CONFIG_PACKAGE_CORE_COREUTILS=y
CONFIG_PACKAGE_CORE_E2FSPROGS=y
CONFIG_PACKAGE_CORE_UDEV_DISABLE_EXTRAS=y
# CONFIG_PACKAGE_CORE_UTIL_LINUX_NCURSES is not set
CONFIG_PACKAGE_NET_DHCPCD=y
CONFIG_PACKAGE_NET_ETHTOOL=y
CONFIG_PACKAGE_UTIL_ADAK=y
CONFIG_PACKAGE_UTIL_I2C_TOOLS=y
CONFIG_PACKAGE_UTIL_MTD_UTILS=y
CONFIG_PACKAGE_VENDOR_AVIONIC_DESIGN_MEDCOM_WIDE_UTILS=y
```

## configs/tec-initrd_defconfig
```kconfig
CONFIG_ARCH_ARM=y
CONFIG_ARCH_ARM_CPU_CORTEX_A9=y
CONFIG_ARCH_TEGRA_2x_SOC=y
CONFIG_ARCH_ARM_ABI_EABI=y
CONFIG_OS_LINUX=y
CONFIG_PLATFORM_AVIONIC_DESIGN=y
CONFIG_PACKAGE_KERNEL_LINUX_CONFIG="tegra_defconfig"
CONFIG_PLATFORM_AVIONIC_DESIGN_TEC=y
CONFIG_PACKAGE_KERNEL_LINUX_SOURCE_GIT=y
CONFIG_PACKAGE_KERNEL_LINUX_SOURCE_GIT_URL="git://github.com/avionic-design/linux-l4t.git"
CONFIG_PACKAGE_KERNEL_LINUX_SOURCE_GIT_CHECKOUT="tamonten/l4t-r16-3"
CONFIG_PACKAGE_KERNEL_LINUX_BUILD_DTBS=y
CONFIG_PACKAGE_KERNEL_LINUX_DTB="tegra20-tec"
CONFIG_PACKAGE_CORE_BASE_FILES=y
CONFIG_PACKAGE_UTIL_ADAK=y
```

## configs/tec-rootfs_defconfig
```kconfig
CONFIG_ARCH_ARM=y
CONFIG_MARCH=""
CONFIG_ARCH_ARM_CPU_CORTEX_A9=y
CONFIG_ARCH_TEGRA_2x_SOC=y
CONFIG_ARCH_ARM_ABI_EABI=y
CONFIG_ARCH_ARM_ARCH_V7=y
CONFIG_OS_LINUX=y
CONFIG_GLIBC=y
CONFIG_PLATFORM_AVIONIC_DESIGN=y
CONFIG_PACKAGE_KERNEL_LINUX_CONFIG="tegra_defconfig"
CONFIG_PLATFORM_AVIONIC_DESIGN_TAMONTEN=y
CONFIG_PLATFORM_AVIONIC_DESIGN_TAMONTEN_TEC=y
CONFIG_PLATFORM_AVIONIC_DESIGN_TAMONTEN_TEC_ROOTFS=y
CONFIG_PACKAGE_BUILD_TOOLS_GDK_PIXBUF=y
CONFIG_PACKAGE_KERNEL_LINUX_SOURCE_LOCAL=y
CONFIG_PACKAGE_KERNEL_LINUX_SOURCE_LOCAL_PATH="../kernel/linux-ipmp.git"
CONFIG_PACKAGE_KERNEL_LINUX_BUILD_DTBS=y
CONFIG_PACKAGE_KERNEL_LINUX_DTB="tegra20-tec"
CONFIG_PACKAGE_DEVEL_GDB=y
CONFIG_PACKAGE_DEVEL_STRACE=y
CONFIG_PACKAGE_CORE_BASE_FILES=y
CONFIG_PACKAGE_CORE_BUSYBOX=y
CONFIG_PACKAGE_CORE_COREUTILS=y
CONFIG_PACKAGE_CORE_LESS=y
CONFIG_PACKAGE_CORE_LM_SENSORS=y
CONFIG_PACKAGE_CORE_PCIUTILS=y
CONFIG_PACKAGE_CORE_PROCPS=y
CONFIG_PACKAGE_CORE_PSMISC=y
CONFIG_PACKAGE_CORE_RSYSLOG=y
CONFIG_PACKAGE_CORE_UTIL_LINUX_PAM=y
CONFIG_PACKAGE_LIBS_LIBJPEG=y
CONFIG_PACKAGE_SHELLS_BASH=y
CONFIG_PACKAGE_NET_DHCPCD=y
CONFIG_PACKAGE_NET_ETHTOOL=y
CONFIG_PACKAGE_NET_IFLINKD=y
CONFIG_PACKAGE_NET_LLDPD=y
CONFIG_PACKAGE_NET_LLDPD_SNMP=y
CONFIG_PACKAGE_NET_NTPD=y
CONFIG_PACKAGE_NET_FUSE_SSHFS=y
CONFIG_PACKAGE_NET_TCPDUMP=y
CONFIG_PACKAGE_CONSOLE_KBD=y
CONFIG_PACKAGE_EDITORS_NANO=y
CONFIG_PACKAGE_EDITORS_VIM=y
CONFIG_PACKAGE_MULTIMEDIA_ALSA_UTILS=y
CONFIG_PACKAGE_MULTIMEDIA_GSTREAMER_PLUGINS_BASE=y
CONFIG_PACKAGE_XORG_DRIVER_INPUT_EVDEV=y
CONFIG_PACKAGE_XORG_DRIVER_INPUT_EVDEV_MULTITOUCH=y
CONFIG_PACKAGE_XORG_DRIVER_VIDEO_OPENTEGRA=y
CONFIG_PACKAGE_XORG_APP_EVTEST=y
CONFIG_PACKAGE_XORG_APP_SETXKBMAP=y
CONFIG_PACKAGE_XORG_APP_XAUTH=y
CONFIG_PACKAGE_XORG_APP_XINIT=y
CONFIG_PACKAGE_XORG_APP_XINPUT=y
CONFIG_PACKAGE_XORG_APP_XKBCOMP=y
CONFIG_PACKAGE_XORG_APP_XRANDR=y
CONFIG_PACKAGE_XORG_APP_XSET=y
CONFIG_PACKAGE_XORG_APP_XTERM=y
CONFIG_PACKAGE_XORG_APP_XVINFO=y
CONFIG_PACKAGE_XORG_DATA_XKEYBOARD_CONFIG=y
CONFIG_XORG_DRI=y
CONFIG_XORG_GLX=y
CONFIG_XORG_XV=y
CONFIG_PACKAGE_DESKTOP_NODM=y
CONFIG_PACKAGE_DESKTOP_WAYLAND_WESTON=y
CONFIG_PACKAGE_WM_AWESOME=y
CONFIG_PACKAGE_WM_I3=y
CONFIG_PACKAGE_UTIL_ADAK=y
CONFIG_PACKAGE_UTIL_HTOP=y
CONFIG_PACKAGE_UTIL_I2C_TOOLS=y
CONFIG_PACKAGE_UTIL_MESA_DEMOS=y
CONFIG_PACKAGE_UTIL_MTD_UTILS=y
CONFIG_PACKAGE_FONTS_TTF_BITSTREAM_VERA=y
CONFIG_PACKAGE_FONTS_TTF_FREEFONT=y
CONFIG_PACKAGE_FONTS_TTF_LIBERATION=y
CONFIG_OPENGL_MESA_OPENGL_ES1=y
CONFIG_OPENGL_MESA_OPENGL_ES2=y
CONFIG_OPENGL_MESA_OPENGL=y
CONFIG_UDEV_SYSTEMD=y
```

## medatom-ng/Kconfig
```kconfig
if PLATFORM_AVIONIC_DESIGN_MEDATOM_NG

choice
	prompt "Avionic Design Med@om NextGen"

source "platforms/avionic-design/medatom-ng/initrd/Kconfig"
source "platforms/avionic-design/medatom-ng/rootfs/Kconfig"

endchoice

endif
```

## medatom-ng/initrd/Kconfig
```kconfig
config PLATFORM_AVIONIC_DESIGN_MEDATOM_NG_INITRD
	select PLATFORM_GENERIC_INITRD
	bool "Initial Ramdisk"
```

## medatom-ng/rootfs/Kconfig
```kconfig
config PLATFORM_AVIONIC_DESIGN_MEDATOM_NG_ROOTFS
	bool "Root Filesystem"
	select PACKAGE_BUILD_TOOLS_SQUASHFS
	select PACKAGE_CORE_SYSTEMD
	select PACKAGE_CORE_RSYSLOG
	select PACKAGE_DESKTOP_AWESOME
	select PACKAGE_NET_REMOTE_CONTROL
```

## medatom/Kconfig
```kconfig
if PLATFORM_AVIONIC_DESIGN_MEDATOM

choice
	prompt "Avionic Design Med@om"

source "platforms/avionic-design/medatom/install/Kconfig"
source "platforms/avionic-design/medatom/rootfs/Kconfig"

endchoice

endif
```
