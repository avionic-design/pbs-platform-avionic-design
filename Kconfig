## medatom/initrd/Kconfig
```kconfig
config PLATFORM_AVIONIC_DESIGN_MEDATOM_INITRD
	select PLATFORM_GENERIC_INITRD
	bool "Initial Ramdisk"
```

## medatom/install/Kconfig
```kconfig
config PLATFORM_AVIONIC_DESIGN_MEDATOM_INSTALL
	bool "Avionic Design Medatom Installer Ramdisk"
	select PACKAGE_CORE_BUSYBOX
	select PACKAGE_CORE_SYSLINUX
	select PACKAGE_CORE_UDEV
	select PACKAGE_CORE_UTIL_LINUX
	select PACKAGE_LIBS_DBUS
	select PACKAGE_NET_OPENSSH
	select PACKAGE_UTIL_ADAK
	select PACKAGE_UTIL_FLASHROM
	select PACKAGE_UTIL_FLASHTOOL
	select PACKAGE_UTIL_MEDATOM_UTILS
	select PLATFORM_GENERIC_INSTALL
```

## medatom/rootfs/Kconfig
```kconfig
config PLATFORM_AVIONIC_DESIGN_MEDATOM_ROOTFS
	bool "Root Filesystem"
	select PACKAGE_DESKTOP_AWESOME
	select PACKAGE_NET_REMOTE_CONTROL
```

## medcom-wide/Kconfig
```kconfig
if PLATFORM_AVIONIC_DESIGN_MEDCOM_WIDE

choice
	prompt "Avionic Design Medcom-Wide"

source "platforms/avionic-design/medcom-wide/initrd/Kconfig"
source "platforms/avionic-design/medcom-wide/rootfs/Kconfig"

endchoice

endif
```

## medcom-wide/initrd/Kconfig
```kconfig
config PLATFORM_AVIONIC_DESIGN_MEDCOM_WIDE_INITRD
	select PLATFORM_GENERIC_INITRD
	select PACKAGE_BUILD_TOOLS_UBOOT
	bool "Initial Ramdisk"
```

## medcom-wide/rootfs/Kconfig
```kconfig
config PLATFORM_AVIONIC_DESIGN_MEDCOM_WIDE_ROOTFS
	bool "Root Filesystem"
	select PACKAGE_BUILD_TOOLS_SQUASHFS

if PLATFORM_AVIONIC_DESIGN_MEDCOM_WIDE_ROOTFS

config PLATFORM_AVIONIC_DESIGN_MEDCOM_WIDE_ROOTFS_DEFAULTS
	bool "defaults"
	select PACKAGE_VENDOR_NVIDIA_TEGRA2_L4T
	select PACKAGE_VENDOR_AVIONIC_DESIGN_RUM
	select PACKAGE_VENDOR_AVIONIC_DESIGN_MEDCOM_WIDE_UTILS
	select PACKAGE_VENDOR_AVIONIC_DESIGN_REMOTE_CONTROL_AUDIO_ALSA
	select PACKAGE_VENDOR_AVIONIC_DESIGN_REMOTE_CONTROL_BACKLIGHT_SYSFS
	select PACKAGE_VENDOR_AVIONIC_DESIGN_REMOTE_CONTROL_VIDEO_VLC
	select PACKAGE_VENDOR_AVIONIC_DESIGN_REMOTE_CONTROL_SMARTCARD_LIBSMARTCARD
	select PACKAGE_VENDOR_AVIONIC_DESIGN_REMOTE_CONTROL_VOIP_LINPHONE
	select PACKAGE_VENDOR_AVIONIC_DESIGN_REMOTE_CONTROL_GPIO_SYSFS
	select PACKAGE_VENDOR_AVIONIC_DESIGN_REMOTE_CONTROL_JAVASCRIPT_APP_WATCHDOG
	select PACKAGE_VENDOR_AVIONIC_DESIGN_REMOTE_CONTROL_WATCHDOG
	select PACKAGE_MULTIMEDIA_GSTREAMER_0_10_PLUGINS_UGLY
	select PACKAGE_MULTIMEDIA_VLC_TELETEXT
	select PACKAGE_MULTIMEDIA_VLC_PLUGIN_GLES2
	select PACKAGE_WEB_WEBKIT_GTK_UNICODE_BACKEND_ICU
	select PACKAGE_WEB_WEBKIT_GTK_ENABLE_VIDEO
	select PACKAGE_CORE_BUSYBOX
	select PACKAGE_CORE_COREUTILS
	select PACKAGE_CORE_PROCPS
	select PACKAGE_CORE_SYSTEMD
	select PACKAGE_CORE_RSYSLOG
	select PACKAGE_LIBS_LIBSMARTCARD
	select PACKAGE_LIBS_SYSFSUTILS
	select PACKAGE_LIBS_GLIB_NETWORKING
	select PACKAGE_CONSOLE_KBD
	select PACKAGE_SHELLS_BASH
	select PACKAGE_NET_DDIP
	select PACKAGE_NET_DHCPCD
	select PACKAGE_NET_IFLINKD
	select PACKAGE_NET_LLDPD
	select PACKAGE_NET_NTPD
	select PACKAGE_NET_OPENSSH
	select PACKAGE_NET_PROXYCONF
	select PACKAGE_NET_WPA_SUPPLICANT
	select PACKAGE_EDITORS_NANO
	select PACKAGE_MULTIMEDIA_ALSA_UTILS
	select PACKAGE_DESKTOP_EVDEV_CALIBRATE
	select PACKAGE_DESKTOP_ICONS_TANGO
	select PACKAGE_DESKTOP_NODM
	select PACKAGE_XORG_APP_SETXKBMAP
	select PACKAGE_XORG_APP_XINIT
	select PACKAGE_XORG_APP_XKBCOMP
	select PACKAGE_XORG_DATA_XKEYBOARD_CONFIG
	select PACKAGE_XORG_DRIVER_INPUT_EVDEV
	select PACKAGE_XORG_DRIVER_INPUT_KEYBOARD
	select PACKAGE_XORG_DRIVER_INPUT_MOUSE
	select XORG_XV
	select PACKAGE_UTIL_ADAK
	select PACKAGE_WEB_X11VNC
	select PACKAGE_FONTS_TTF_BITSTREAM_VERA
	select PACKAGE_FONTS_TTF_FREEFONT
	select PACKAGE_FONTS_TTF_LIBERATION
	select HAVE_OPENGL_ES
	select VIRTUAL_OPENGL_ES
	select OPENGL_NVIDIA_L4T_T2
	select PACKAGE_WM_DWM
	select PACKAGE_WM_DWM_PATCH_REMOTE_CONTROL
	help
	  Default package selection for working rootfs

config PLATFORM_AVIONIC_DESIGN_MEDCOM_WIDE_ROOTFS_DEVEL
	bool "Development"
	select PACKAGE_CORE_PSMISC
	select PACKAGE_CORE_LESS
	select PACKAGE_CORE_GREP
	select PACKAGE_DEVEL_GDB
	select PACKAGE_DEVEL_STRACE
	select PACKAGE_CONSOLE_TMUX
	select PACKAGE_EDITORS_VIM
	select PACKAGE_UTIL_HTOP
	select PACKAGE_UTIL_I2C_TOOLS
	select PACKAGE_XORG_APP_EVTEST
	select PACKAGE_XORG_APP_XRANDR
	select PACKAGE_XORG_APP_XTERM
	help
	  Packages for development, can be dropped on release build

config PLATFORM_AVIONIC_DESIGN_MEDCOM_WIDE_ROOTFS_DEBUG
	bool "Debugging"
	select PACKAGE_CORE_E2FSPROGS
	select PACKAGE_NET_ETHTOOL
	select PACKAGE_NET_IPERF
	select PACKAGE_NET_TCPDUMP
	select PACKAGE_NET_FUSE_SSHFS
	help
	  Packages only used for debugging

endif
```

## medcom-wide/setup/Kconfig
```kconfig
config PLATFORM_AVIONIC_DESIGN_MEDCOM_WIDE_SETUP
	select PLATFORM_GENERIC_INITRD
	select PACKAGE_BUILD_TOOLS_UBOOT
	bool "Setup OS"
	help
	  Create an initramfs without rootfs to setup a new device. The image is
	  is intended to be loaded via TFTP from U-Boot. After booting this OS
	  is capable of configuring the I2C sensor bars and flashing an SD card
	  with production images.
```

## plutux/Kconfig
```kconfig
if PLATFORM_AVIONIC_DESIGN_PLUTUX

choice
	prompt "Avionic Design Plutux"

source "platforms/avionic-design/plutux/initrd/Kconfig"
source "platforms/avionic-design/plutux/rootfs/Kconfig"

endchoice

source "platforms/avionic-design/plutux/binaries/Kconfig"

endif
```

## plutux/binaries/Kconfig
```kconfig
if PLATFORM_AVIONIC_DESIGN_PLUTUX_ROOTFS

config PLATFORM_AVIONIC_DESIGN_PLUTUX_BINARIES
	bool "Avionic Design Plutux Binaries"
	default n
	help
	  This package contains all binaries shipped with nvidia's sdk.
	  It contains the x display driver and the codecs to use hardware
	  accelerated video playback and OpenGL.

endif
```

## plutux/initrd/Kconfig
```kconfig
config PLATFORM_AVIONIC_DESIGN_PLUTUX_INITRD
	select PLATFORM_GENERIC_INITRD
	bool "Initial Ramdisk"
```

## plutux/rootfs/Kconfig
```kconfig
config PLATFORM_AVIONIC_DESIGN_PLUTUX_ROOTFS
	bool "Root Filesystem"
	select PACKAGE_BUILD_TOOLS_SQUASHFS
```

## tamonten/Kconfig
```kconfig
if PLATFORM_AVIONIC_DESIGN_TAMONTEN

choice
	prompt "Avionic Design Tamonten"

config PLATFORM_AVIONIC_DESIGN_TAMONTEN_PLUTUX
	bool "Avionic Design Plutux"

config PLATFORM_AVIONIC_DESIGN_TAMONTEN_MEDCOM_WIDE
	bool "Avionic Design Medcom Wide"

config PLATFORM_AVIONIC_DESIGN_TAMONTEN_TEC
	bool "Avionic Design Tamonten Evaluation Carrier"

endchoice

source "platforms/avionic-design/tamonten/plutux/Kconfig"
source "platforms/avionic-design/tamonten/medcom-wide/Kconfig"
source "platforms/avionic-design/tamonten/tec/Kconfig"

endif
```

## tamonten/medcom-wide/Kconfig
```kconfig
if PLATFORM_AVIONIC_DESIGN_TAMONTEN_MEDCOM_WIDE

choice
	prompt "Avionic Design Medcom Wide"

source "platforms/avionic-design/tamonten/medcom-wide/initrd/Kconfig"
source "platforms/avionic-design/tamonten/medcom-wide/rootfs/Kconfig"

endchoice

endif
```
